## config/boards/shields/ericht_samoklava/Kconfig.defconfig
```kconfig
# Copyright (c) 2022 The ZMK Contributors
# SPDX-License-Identifier: MIT

if SHIELD_ERICHT_SAMOKLAVA_LEFT

config ZMK_KEYBOARD_NAME
	default "ericht-samoklava"

config ZMK_SPLIT_BLE_ROLE_CENTRAL
	default y

endif

if SHIELD_ERICHT_SAMOKLAVA_LEFT || SHIELD_ERICHT_SAMOKLAVA_RIGHT

config ZMK_SPLIT
	default y

endif
```

## config/boards/shields/ericht_samoklava/Kconfig.shield
```kconfig
# Copyright (c) 2022 The ZMK Contributors
# SPDX-License-Identifier: MIT

config SHIELD_ERICHT_SAMOKLAVA_LEFT
	def_bool $(shields_list_contains,ericht_samoklava_left)

config SHIELD_ERICHT_SAMOKLAVA_RIGHT
	def_bool $(shields_list_contains,ericht_samoklava_right)
```
